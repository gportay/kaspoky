## Kconfig
```kconfig
config KAS_INCLUDE_MAIN
	string
	default "kas-project.yml"

config KAS_BUILD_SYSTEM
	string
	default "openembedded"

choice MACHINE
	prompt "machine"
	default RASPBERRYPI4_64

config QEMUX86_64
	bool "qemux86-64"
	help
	  Machine configuration for running an x86-64 system on QEMU.

config RASPBERRYPI4_64
	bool "raspberrypi4-64"
	help
	  Machine configuration for the RaspberryPi 4 in 64 bits mode.

endchoice

config KAS_TARGET_CHOICE
	string
	default "target1" if CHOICE1
	default "target2" if CHOICE2

choice LINUX_KERNEL
	prompt "kernel"
	default LINUX_YOCTO
	default LINUX_YOCTO if QEMUX86_64
	default LINUX_RASPBERRYPI if RASPBERRYPI4_64

config LINUX_YOCTO
	bool "linux-yocto"

config LINUX_STABLE
	bool "linux-stable"
	help
	  These recipes follow the patch releases in each currently supported
	  stable release series of the Linux kernel. The currently supported
	  release series can be seen at https://www.kernel.org/.

config LINUX_MAINLINE
	bool "linux-mainline"
	help
	  This recipe uses AUTOREV to pull the latest commit to the master
	  branch of the mainline Linux repository. As this branch includes
	  release candidate (rc) kernels it is only recommended for testing and
	  active development.

config LINUX_RASPBERRYPI
	bool "linux-raspberrypi"

endchoice

config KAS_INCLUDE_LINUX_STABLE
	string
	default "linux-stable.yml"
	depends on LINUX_STABLE

config KAS_INCLUDE_LINUX_MAINLINE
	string
	default "linux-mainline.yml"
	depends on LINUX_MAINLINE
```
